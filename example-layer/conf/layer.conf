## example-layer/conf/layer.conf
```bitbake
BBPATH .= ":${LAYERDIR}"

BBFILES += "${LAYERDIR}/recipes-*/*/*.bb \
            ${LAYERDIR}/recipes-*/*/*.bbappend"

BBFILE_COLLECTIONS += "meta-rubikpi3"
BBFILE_PATTERN_meta-rubikpi3 = "^${LAYERDIR}/"
BBFILE_PRIORITY_meta-rubikpi3 = "6"

LAYERVERSION_meta-rubikpi3 = "1"
LAYERSERIES_COMPAT_meta-rubikpi3 = "kirkstone langdale mickledore nanbield scarthgap"
```
